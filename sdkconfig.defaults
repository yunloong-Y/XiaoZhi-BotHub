## sdkconfig.defaults
```kconfig
# 小智AI-BotHub 默认配置 — ESP32-S3 N16R8
CONFIG_IDF_TARGET="esp32s3"
CONFIG_ESPTOOLPY_FLASHSIZE_16MB=y
CONFIG_ESPTOOLPY_FLASHMODE_QIO=y

CONFIG_ESP_DEFAULT_CPU_FREQ_MHZ_240=y

# 8MB 八线 PSRAM
CONFIG_SPIRAM=y
CONFIG_SPIRAM_MODE_OCT=y
CONFIG_SPIRAM_SPEED_80M=y
CONFIG_SPIRAM_MALLOC_ALWAYSINTERNAL=1024
CONFIG_SPIRAM_MALLOC_RESERVE_INTERNAL=32768
CONFIG_SPIRAM_MEMTEST=n

# 摄像头 DMA：内部 bounce buffer 提高 DVP 稳定性
CONFIG_CAMERA_PSRAM_DMA=n
CONFIG_CAMERA_DMA_BUFFER_SIZE_MAX=16384

# 分区表
CONFIG_PARTITION_TABLE_CUSTOM=y
CONFIG_PARTITION_TABLE_CUSTOM_FILENAME="partitions/partitions_16mb.csv"
CONFIG_PARTITION_TABLE_FILENAME="partitions/partitions_16mb.csv"

# 编译器优化
CONFIG_COMPILER_OPTIMIZATION_SIZE=y

# FreeRTOS / 日志
CONFIG_FREERTOS_HZ=1000
CONFIG_LOG_DEFAULT_LEVEL_INFO=y

# Console 走 USB Serial/JTAG：日志与 stdin 都走 USB 口，串口命令可用
CONFIG_ESP_CONSOLE_USB_SERIAL_JTAG=y
CONFIG_ESP_CONSOLE_UART_DEFAULT=n
CONFIG_ESP_CONSOLE_SECONDARY_NONE=y
CONFIG_NEWLIB_STDIN_LINE_ENDING_LF=y

# esp_codec_dev：启用 ES8311 / ES7210 器件支持
CONFIG_CODEC_ES8311_SUPPORT=y
CONFIG_CODEC_ES7210_SUPPORT=y
```
